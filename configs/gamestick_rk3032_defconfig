## configs/gamestick_rk3032_defconfig
```kconfig
# =============================================================================
# GameStick Lite 4K (M8) — Buildroot defconfig
# Cible : Rockchip RK3032 (Cortex-A7, ARMv7-A, VFPv4, NEON, 256 Mo RAM)
# =============================================================================

# --- Architecture ARM ---
BR2_arm=y
BR2_DOWNLOAD_FORCE_CHECK_HASHES=n
BR2_cortex_a7=y
BR2_ARM_EABIHF=y
BR2_ARM_FPU_NEON_VFPV4=y
BR2_ARM_INSTRUCTIONS_THUMB2=y
BR2_OPTIMIZE_2=y
BR2_SHARED_LIBS=y
BR2_TARGET_OPTIMIZATION="-U_TIME_BITS -D_TIME_BITS=32"
# --- Toolchain ---
BR2_KERNEL_HEADERS_VERSION=y
BR2_PACKAGE_HOST_LINUX_HEADERS_CUSTOM_4_4=y
BR2_DEFAULT_KERNEL_HEADERS="4.4.302"
BR2_DEFAULT_KERNEL_VERSION="4.4.302"
BR2_PACKAGE_GLIBC_KERNEL_COMPAT=y
BR2_TOOLCHAIN_BUILDROOT_CXX=y
BR2_TOOLCHAIN_BUILDROOT_WCHAR=y
BR2_TOOLCHAIN_HAS_SSP=n
BR2_SSP_NONE=y
BR2_RELRO_NONE=y
BR2_FORTIFY_SOURCE_NONE=y

# --- Système ---
BR2_INIT_BUSYBOX=y
BR2_SYSTEM_BIN_SH_BUSYBOX=y
BR2_TARGET_GENERIC_HOSTNAME="gamestick"
BR2_TARGET_GENERIC_ISSUE="GameStick Lite 4K - Custom RetroArch Build"
BR2_TARGET_GENERIC_GETTY_PORT="console"
BR2_TARGET_GENERIC_GETTY_BAUDRATE_115200=y
BR2_ROOTFS_OVERLAY="$(TOPDIR)/../overlay"

# --- Pas de kernel/bootloader (on garde ceux d'origine) ---
BR2_LINUX_KERNEL=n

# --- Filesystem ---
BR2_TARGET_ROOTFS_EXT2=y
BR2_TARGET_ROOTFS_EXT2_4=y
BR2_TARGET_ROOTFS_EXT2_SIZE="256M"
BR2_TARGET_ROOTFS_TAR=y

# --- Paquets système de base ---
BR2_PACKAGE_BUSYBOX=y
BR2_PACKAGE_BUSYBOX_SHOW_OTHERS=y
BR2_PACKAGE_BASH=y
BR2_PACKAGE_DOSFSTOOLS=y
BR2_PACKAGE_SEEDRNG=n

# --- Ajout dépendance RetroArch
BR2_ROOTFS_DEVICE_CREATION_DYNAMIC_EUDEV=y

# --- Graphique / Vidéo ---
BR2_PACKAGE_LIBDRM=y

# --- Audio ---
BR2_PACKAGE_ALSA_LIB=y
BR2_PACKAGE_ALSA_UTILS=y
BR2_PACKAGE_ALSA_UTILS_AMIXER=y
BR2_PACKAGE_ALSA_UTILS_APLAY=y

# --- Input (manettes) ---
BR2_PACKAGE_EUDEV=y
BR2_PACKAGE_EVTEST=y

# --- Libs graphiques ---
BR2_PACKAGE_ZLIB=y
BR2_PACKAGE_LIBPNG=y
BR2_PACKAGE_FREETYPE=y

# --- Outils debug ---
BR2_PACKAGE_STRACE=y
BR2_PACKAGE_GDB=y
BR2_PACKAGE_GDB_DEBUGGER=y
BR2_STRIP_NONE=y
BR2_ENABLE_DEBUG=y

# --- RetroArch ---
BR2_PACKAGE_RETROARCH=y

# --- Cores libretro ---
BR2_PACKAGE_LIBRETRO_FCEUMM=n
BR2_PACKAGE_LIBRETRO_GAMBATTE=n
BR2_PACKAGE_LIBRETRO_MGBA=n
BR2_PACKAGE_LIBRETRO_SNES9X2005=y
BR2_PACKAGE_LIBRETRO_GENESIS_PLUS_GX=n
BR2_PACKAGE_LIBRETRO_NESTOPIA=n
BR2_PACKAGE_LIBRETRO_PICODRIVE=n
BR2_PACKAGE_LIBRETRO_MEDNAFEN_PCE_FAST=n
BR2_PACKAGE_LIBRETRO_MEDNAFEN_SUPERGRAFX=n
BR2_PACKAGE_LIBRETRO_MEDNAFEN_NGP=n
BR2_PACKAGE_LIBRETRO_MEDNAFEN_WSWAN=n
BR2_PACKAGE_LIBRETRO_FBNEO=n
BR2_PACKAGE_LIBRETRO_MAME2003_PLUS=n
BR2_PACKAGE_LIBRETRO_CAP32=n
BR2_PACKAGE_LIBRETRO_FUSE=n
BR2_PACKAGE_LIBRETRO_VICE_X64=n
BR2_PACKAGE_LIBRETRO_THEODORE=n
BR2_PACKAGE_LIBRETRO_PCSX_REARMED=n
BR2_PACKAGE_LIBRETRO_STELLA=n
BR2_PACKAGE_LIBRETRO_PROSYSTEM=n
BR2_PACKAGE_LIBRETRO_HANDY=n
```
